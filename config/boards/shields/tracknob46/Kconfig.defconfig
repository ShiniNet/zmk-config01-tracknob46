## config/boards/shields/tracknob46/Kconfig.defconfig
```kconfig
# Copyright (c) 2020 The ZMK Contributors
# SPDX-License-Identifier: MIT

if SHIELD_TRACKNOB46_RIGHT

config ZMK_KEYBOARD_NAME
    default "tracknob46"

config ZMK_SPLIT_ROLE_CENTRAL
    default y

endif

if SHIELD_TRACKNOB46_LEFT || SHIELD_TRACKNOB46_RIGHT

config ZMK_SPLIT
    default y

endif

config I2C
    default y
    
config SSD1306
    default y
```

## config/boards/shields/tracknob46/Kconfig.shield
```kconfig
# Copyright (c) 2020 The ZMK Contributors
# SPDX-License-Identifier: MIT

config SHIELD_TRACKNOB46_LEFT
    def_bool $(shields_list_contains,tracknob46_left)

config SHIELD_TRACKNOB46_RIGHT
    def_bool $(shields_list_contains,tracknob46_right)
```
